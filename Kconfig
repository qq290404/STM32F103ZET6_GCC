## Kconfig
```kconfig
mainmenu "STM32 Configuration"

menu "Platform Select"
    choice
        prompt "MCU Type"
        default STM32F103ZET6

        config STM32F103ZET6
            bool "STM32F103ZET6"
            help
                STM32 shenzhou iii board
	endchoice
endmenu

menu "Fireware space allocation"
	config IBOOT_MAX_SIZE
		hex "IBOOT Max Size"
		default 0x8800
		help
			iboot bin max size

	config XBOOT_MAX_SIZE
		hex "XBOOT Max Size"
		default 0x7800
		help
			xboot image max size

	config UBOOT_MAX_SIZE
		hex "UBOOT Max Size"
		default 0x7800
		help
			uboot image max size

	config APP_MAX_SIZE
		hex "APP Max Size"
		default 0x32000
		help
			app image max size
endmenu

config SDK_RELEASE
    bool "SDK_RELEASE"
    default n
    help
        SDK RELEASE

source "app/Kconfig"
```

## app/Kconfig
```kconfig
menu "USER SELECT"
	choice USER_FIRM
		bool "USER FIRM"
        default USER_FIRM_NAME_SELF

		config USER_FIRM_NAME_SELF
			bool "Mingguang.Li"

	endchoice

	choice USER_PRODUCT
		bool "USER PRODUCT"
        default USER_PRODUCT_DEMO

		config USER_PRODUCT_DEMO
			bool "Demo"

	endchoice

endmenu
```
